## conf/bblayers.conf
```bitbake
BBPATH := "${TOPDIR}"
BBFILES ?= ""

# Add your layer to BBLAYERS.
BBLAYERS ?= " \
          ${TOPDIR}/mylayer \
       "
```

## mylayer/conf/layer.conf
```bitbake
# Add the path of this layer to BBPATH
BBPATH .= ":${LAYERDIR}"

# Append files to BBFILES
BBFILES += "${LAYERDIR}/*.bb"

# Set layer search pattern and priority
BBFILE_COLLECTIONS += "mylayer"
BBFILE_PATTERN_mylayer := "^${LAYERDIR}/"
BBFILE_PRIORITY_mylayer = "5"
```
